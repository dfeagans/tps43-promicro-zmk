## config/west.yml
```yaml
manifest:
  remotes:
    - name: zmkfirmware
      url-base: https://github.com/zmkfirmware
  projects:
    - name: zmk
      remote: zmkfirmware
      revision: main
  self:
    path: config

boards:
  - board: rp2040_promicro

sensor-behaviors:
  - sensor: tps43
    driver: cirque_pinnacle
    bus: i2c
    i2c:
      sda-pin: GP0
      scl-pin: GP28
    dr-pin: GP29
    invert-x: false
    invert-y: true
    gestures:
      tap-to-click: true
      tap-and-drag: true
      two-finger-scroll: true
      natural-scroll: true
```
